## conf/layer.conf
```bitbake
# Layer configuration for meta-handheld layer
# Copyright 2011 Intel Corporation

# palmOne Zire 72 layer configuration files
# Copyright 2017-2018 CSG Systems

# We have a conf and classes directory, append to BBPATH
BBPATH .= ":${LAYERDIR}"

# We have a recipes directory, add to BBFILES
BBFILES += "${LAYERDIR}/recipes-*/*/*.bb ${LAYERDIR}/recipes-*/*/*.bbappend"

BBFILE_COLLECTIONS += "meta-ghackndev"
BBFILE_PATTERN_meta-handheld := "^${LAYERDIR}/"

# Define the priority for recipes (.bb files) from this layer,
# choosing carefully how this layer interacts with all of the
# other layers.

BBFILE_PRIORITY_meta-handheld = "7"

LAYERDEPENDS_meta-handheld = "core meta-initramfs"
```

## conf/machine/z72.conf
```bitbake
#@TYPE: Machine
#@NAME: Palm Zire 72
#@DESCRIPTION: Machine configuration for the Zire 72 with a pxa27x CPU

#
# Hardware-based properties
#
require conf/machine/include/tune-xscale.inc

MACHINE_FEATURES += "iwmmxt"
PACKAGE_EXTRA_ARCHS_tune-xscale += "iwmmxt"

MACHINE_GUI_CLASS = "smaallscreen"
MACHINE_DISPLAY_WIDTH_PIXELS = "320"
MACHINE_DISPLAY_HEIGHT_PIXELS = "320"
MACHINE_FEATURES = "alsa apm bluetooth irda screen touchscreen usbgadget vfat"

#
# Software/packages selection
#
PREFERRED_PROVIDER_virtual/kernel = "linux-handheld"

XSERVER = "xserver-xorg \
           xf86-input-evdev \
           xf86-video-fbdev"

MACHINE_EXTRA_RDEPENDS = "tiinit"
MACHINE_EXTRA_RRECOMMENDS = "\
	kernel-module-i2c-pxa \
	kernel-module-pxa27x-voltage \
	kernel-module-pxa27x-voltage-max158xx \
        keymaps"

KERNEL_IMAGETYPE = "zImage"
XZ_COMPRESSION_LEVEL = "-2e"

IMAGE_FSTYPES += ".gz"

#
# Modules autoload and other boot properties
#
module_autoload_evdev = "evdev"
module_autoload_snd-pcm-oss = "snd-pcm-oss"
module_autoload_snd-mixer-oss = "snd-mixer-oss"
module_autoload_pxa27x_udc = "pxa27x_udc"

#FIXME: this should be controlled by a userspace utility later.
module_autoload_g_ether = "g_ether"

SERIAL_CONSOLE = "115200"
```
